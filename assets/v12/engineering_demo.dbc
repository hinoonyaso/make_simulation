VERSION "V12 engineering demonstration"

NS_ :

BS_:

BU_: ECU_A ECU_B ECU_C

BO_ 256 MotorSpeedCommand: 8 ECU_A
 SG_ target_rpm : 0|16@1+ (1,0) [0|10000] "rpm" ECU_B
 SG_ enable : 16|1@1+ (1,0) [0|1] "" ECU_B

BO_ 512 MotorStatus: 8 ECU_B
 SG_ measured_rpm : 0|16@1+ (1,0) [0|10000] "rpm" ECU_A
 SG_ torque_nm : 16|16@1+ (0.1,0) [0|500] "Nm" ECU_A

BO_ 768 BatteryStatus: 8 ECU_C
 SG_ voltage_v : 0|16@1+ (0.01,0) [0|1000] "V" ECU_A
 SG_ current_a : 16|16@1- (0.1,0) [-3000|3000] "A" ECU_A
